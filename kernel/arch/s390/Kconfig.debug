## kernel/arch/s390/Kconfig.debug
```kconfig
menu "Kernel hacking"

config TRACE_IRQFLAGS_SUPPORT
	bool
	default y

source "lib/Kconfig.debug"

config STRICT_DEVMEM
	def_bool y
	prompt "Filter access to /dev/mem"
	---help---
	  This option restricts access to /dev/mem.  If this option is
	  disabled, you allow userspace access to all memory, including
	  kernel and userspace memory. Accidental memory access is likely
	  to be disastrous.
	  Memory access is required for experts who want to debug the kernel.

	  If you are unsure, say Y.


endmenu
```

## kernel/drivers/net/wireless/brcm80211/Kconfig
```kconfig
config BRCMUTIL
	tristate

config BRCMSMAC
	tristate "Broadcom IEEE802.11n PCIe SoftMAC WLAN driver"
	depends on MAC80211
	depends on BCMA
	select BRCMUTIL
	select FW_LOADER
	select CRC_CCITT
	select CRC8
	select CORDIC
	---help---
	  This module adds support for PCIe wireless adapters based on Broadcom
	  IEEE802.11n SoftMAC chipsets.  If you choose to build a module, it'll
	  be called brcmsmac.ko.

config BRCM_TRACING
	bool "Broadcom device tracing"
	depends on BRCMSMAC || BRCMFMAC
	---help---
	  If you say Y here, the Broadcom wireless drivers will register
	  with ftrace to dump event information into the trace ringbuffer.
	  Tracing can be enabled at runtime to aid in debugging wireless
	  issues. This option adds a small amount of overhead when tracing
	  is disabled. If unsure, say Y to allow developers to better help
	  you when wireless problems occur.

config BRCMDBG
	bool "Broadcom driver debug functions"
	depends on BRCMSMAC || BRCMFMAC
	---help---
	  Selecting this enables additional code for debug purposes.
```

## kernel/firmware/carl9170fw/Kconfig
```kconfig
mainmenu "CARL9170 Firmware Configuration"

source "carlfw/Kconfig"
source "minifw/Kconfig"
source "tools/Kconfig"
```

## kernel/firmware/carl9170fw/carlfw/Kconfig
```kconfig
menu "General"

config CARL9170FW_RELEASE_VERSION
	int
	default 1

menu "Selectable Hardware Options"

choice
	prompt "Receiver Max. Frame Length"
	default CARL9170FW_RX_FRAME_LEN_8192

	config CARL9170FW_RX_FRAME_LEN_4096
		bool "4096"

	config CARL9170FW_RX_FRAME_LEN_8192
		bool "8192"

	config CARL9170FW_RX_FRAME_LEN_16384
		bool "16384"

	config CARL9170FW_RX_FRAME_LEN_32768
		bool "32768"

endchoice

config CARL9170FW_RX_FRAME_LEN
	int
	default 4096 if CARL9170FW_RX_FRAME_LEN_4096
	default 8192 if CARL9170FW_RX_FRAME_LEN_8192
	default 16384 if CARL9170FW_RX_FRAME_LEN_16384
	default 32768 if CARL9170FW_RX_FRAME_LEN_32768

config CARL9170FW_GPIO_INTERRUPT
	def_bool y
	prompt "GPIO Software Interrupt"
	---help---
	 When this option is enabled, the firmware will poll the GPIO
	 registers and reports to the driver whenever the GPIO state
	 has changed from a previous state.

	 Note: This feature is necessary to monitor the WPS button,
	       if you have one on your device, then say Y.

config CARL9170FW_SECURITY_ENGINE
	def_bool y
	prompt "Support Hardware Crypto Engine"
	---help---
	 This options controls if the firmware will allow the driver
	 to program the security engine / CAM through a firmware
	 interface.

	 Say Y. Unless you want to do the en- and decryption for
	 CCMP(AES), TKIP/WEP(RC4) in the application anyway.

config CARL9170FW_RADIO_FUNCTIONS
	def_bool y
	prompt "Enable Firmware-supported Radio/RF functions"
	---help---
	 Some PHY/RF functions (e.g.: AGC and Noise calibration) need
	 to be done in the firmware.

	 Say Y, unless you really don't need the Radio/RF for
	 your project.

endmenu

menu "802.11 Firmware Features"

config CARL9170FW_CAB_QUEUE
	def_bool y
	prompt "Support software-based Content after Beacon Queue"
	---help---
	 This (software) queue is used to send any broad-/multi-cast buffered
	 frames after the next DTIM beacon.

	 This feature is required for Accesspoint mode operation.

	 Say Y.

endmenu

source "carlfw/usb/Kconfig"

menu "Experimental, Unstable & Testing Extensions"

config CARL9170FW_PRINTF
	def_bool y
	prompt "Advanced printf"
	depends on CARL9170FW_DEBUG_UART || CARL9170FW_DEBUG_USB
	---help---
	 Advanced printf (very useful for debugging purposes)
	 The formats supported by this implementation are:
		'd' 'u' 'c' 's' 'x' 'X' 'p'.

	 Note: If this option is disabled, the firmware will be only
	       capable of reported _preformated_ string.

config CARL9170FW_EXPERIMENTAL
	def_bool y
	prompt "Experimental Features"

config CARL9170FW_WOL_OPTION
	def_bool n
	prompt "Wakeup on WLAN"
	depends on CARL9170FW_EXPERIMENTAL
	---help---
	 With this option enabled, the firmware can wake-up
	 suspended hosts... As long as they fully support
	 USB remote wakeup.

config CARL9170FW_WOL
	def_bool n
	depends on CARL9170FW_WOL_OPTION

config CARL9170FW_WOL_NL80211_TRIGGERS
	def_bool n
	prompt "Standard NL80211 wakeup triggers"
	depends on CARL9170FW_WOL_OPTION
	select CARL9170FW_WOL
	---help---
	 Available triggers:
	  * Magic Packet(tm) pattern
	  * disconnect event

config CARL9170FW_WOL_PROBE_REQUEST
	def_bool n
	prompt "Probe Request"
	depends on CARL9170FW_WOL_OPTION
	select CARL9170FW_WOL
	---help---
	 Scan probe requests for a given SSID.

config CARL9170FW_WOL_PROBE_REQUEST_SSID
	string
	prompt "Wakeup on WLAN SSID"
	default "CARL9170_WAKEUP"
	depends on CARL9170FW_WOL_PROBE_REQUEST

config CARL9170FW_VIFS_NUM
	default 1
	int
	prompt "Number of additional pseudo virtual interfaces"
	depends on CARL9170FW_EXPERIMENTAL

config CARL9170FW_FW_MAC_RESET
	def_bool y
	prompt "Firmware MAC Chip recovery"
	depends on CARL9170FW_EXPERIMENTAL

config CARL9170FW_NOISY_MAC_RESET
	def_bool n
	prompt "Notify MAC RESET events"
	depends on CARL9170FW_FW_MAC_RESET

config CARL9170FW_BROKEN_FEATURES
	def_bool n
	prompt "Broken Featurs"

config CARL9170FW_DEBUG
	def_bool n
	depends on CARL9170FW_BROKEN_FEATURES && CARL9170FW_PRINTF
	prompt "Enable verbose debugging messages"

config CARL9170FW_DEBUG_LED_HEARTBEAT
	def_bool n
	prompt "LED Heartbeat"
	depends on CARL9170FW_BROKEN_FEATURES
	---help---
	 This option conflicts with the application's LED code.
	 Also, it assumes that you have two LEDs, which is not
	 necessarily true.

config CARL9170FW_DEBUG_UART
	def_bool n
	prompt "Pass debug messages through Highspeed UART"
	depends on CARL9170FW_BROKEN_FEATURES
	---help---
	 This option allows the firmware to send BUG/ERR/INFO/DBG and
	 hexdumps through the UART _as well_. However, first: you must
	 connect a working logger.

config CARL9170FW_WATCHDOG_BUTTON
	def_bool n
	depends on CARL9170FW_BROKEN && CARL9170FW_GPIO_INTERRUPT
	prompt "Trigger Watchdog by pressing the WPS button"

choice CARL9170FW_UART_CLOCK
	prompt "UART Clock"
	depends on CARL9170FW_DEBUG_UART
	default CARL9170FW_UART_CLOCK_40M

config CARL9170FW_UART_CLOCK_25M
	bool "25"

config CARL9170FW_UART_CLOCK_40M
	bool "40"

endchoice

config CARL9170FW_UNUSABLE
	def_bool y
	depends on CARL9170FW_BROKEN || CARL9170FW_DEBUG

config CARL9170FW_USB_MODESWITCH
	def_bool n
	prompt "USB 1.1 / 2.0 switching support"
	depends on CARL9170FW_BROKEN_FEATURES
	---help---
	 Mostly implemented, but untested and some serious
	 doubts remain.

config CARL9170FW_DMA_QUEUE_BUMP
	def_bool n
	prompt "Bump a stuck TX queue before doing a MAC reset"
	depends on CARL9170FW_BROKEN_FEATURES

menu "Build Options"
config CARL9170FW_AGGRESSIVE_CFLAGS
	def_bool y
	prompt "Enable aggressive size optimization"
	---help---
	 This option adds several more optimization compiler flags,
	 which can greatly reduce the firmware size... at the expense
	 of machine-code readability.

	  Say Y. Else the firmware might not fit onto the device!

endmenu

endmenu

endmenu
```

## kernel/firmware/carl9170fw/carlfw/usb/Kconfig
```kconfig
menu "USB Firmware Configuration Settings"

config CARL9170FW_USB_STANDARD_CMDS
	def_bool y
	prompt "Basic USB Interface"
	---help---
	 Allows the device to be queried about Standard USB 2.0 Device
	 Description Descriptors.

	 Say Y, unless you don't care if lsusb -v fails.

config CARL9170FW_USB_UP_STREAM
	def_bool y
	prompt "USB Upload Stream"
	---help---
	 This features allows the USB silicon to combine small, single
	 frames into bigger transfers. This can help to reduce
	 some per-transfer overhead in the application.

	 Say Y, unless you have experienced strange rx corruptions.

config CARL9170FW_USB_DN_STREAM
	def_bool n
	prompt "USB Download Stream"

config CARL9170FW_DEBUG_USB
	def_bool y
	prompt "Pass debug messages through USB transport"
	---help---
	 Report all firmware messages through the USB transport.
	 But there is a catch: In case of a BUG, the USB transport
	 needs to be functional, otherwise the application won't
	 receive anything.

	 Say Y.

endmenu
```

## kernel/firmware/carl9170fw/minifw/Kconfig
```kconfig
config CARL9170FW_BUILD_MINIBOOT
	def_bool y
	prompt "Build MiniBoot Firmware Header"
```

## kernel/firmware/carl9170fw/tools/Kconfig
```kconfig
menu "Firmware Tools"

config CARL9170FW_BUILD_TOOLS
	def_bool y
	prompt "Build Firmware Tools"

config CARL9170FW_BUILD_TOOLS_CARLU
	def_bool n
	prompt "Build CARLU testbench"
	depends on CARL9170FW_BUILD_TOOLS

endmenu
```

## kernel/net/fastsocket/Kconfig
```kconfig
config	FASTSOCKET
	tristate "High performance socket interface (EXPERIMENTAL)"
	default m
	depends on INET
	---help---
	  This option enables high performance socket as its name suggests.

	  Say m if unsure.
```
